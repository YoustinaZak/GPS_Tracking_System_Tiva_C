#include "GPIO.h"


//PortA
void PortA_Init(){
SYSCTL_RCGCGPIO_R |= PORTA_SysRC ;
while((SYSCTL_PRGPIO_R &PORTA_SysRC)==0);
GPIO_PORTA_LOCK_R= GPIO_LOCK_KEY;
	
SET_8bits(GPIO_PORTA_CR_R);   //checked
CLR_8bits(GPIO_PORTA_AFSEL_R); //checked
CLR_4bits(GPIO_PORTA_AMSEL_R); //checked
CLR_32bits(GPIO_PORTA_PCTL_R);
SET_8bits(GPIO_PORTA_DEN_R);   //checked
}

//PortB
void PortB_Init(){
SYSCTL_RCGCGPIO_R |=PORTB_SysRC;
while((SYSCTL_PRGPIO_R &PORTB_SysRC)==0);
GPIO_PORTB_LOCK_R= GPIO_LOCK_KEY;
	
SET_8bits(GPIO_PORTB_CR_R);
CLR_8bits(GPIO_PORTB_AFSEL_R);
CLR_4bits(GPIO_PORTB_AMSEL_R);
CLR_32bits(GPIO_PORTB_PCTL_R);
SET_8bits(GPIO_PORTB_DEN_R);
SET_8bits(GPIO_PORTB_DIR_R); //all o/p for LCD
}

//PortC
void PortC_Init(){
SYSCTL_RCGCGPIO_R |=PORTC_SysRC;
while((SYSCTL_PRGPIO_R &PORTC_SysRC)==0);
GPIO_PORTC_LOCK_R= GPIO_LOCK_KEY;
SET_8bits(GPIO_PORTC_CR_R);
CLR_8bits(GPIO_PORTC_AFSEL_R);
CLR_4bits(GPIO_PORTC_AMSEL_R);
CLR_32bits(GPIO_PORTC_PCTL_R);
SET_8bits(GPIO_PORTC_DEN_R);
}

//PortD
void PortD_Init(){
SYSCTL_RCGCGPIO_R |=PORTC_SysRC;
while((SYSCTL_PRGPIO_R &PORTC_SysRC)==0);
GPIO_PORTD_LOCK_R= GPIO_LOCK_KEY;
SET_8bits(GPIO_PORTD_CR_R);
CLR_8bits(GPIO_PORTD_AFSEL_R);
CLR_4bits(GPIO_PORTD_AMSEL_R);
CLR_32bits(GPIO_PORTD_PCTL_R);
SET_8bits(GPIO_PORTD_DEN_R);
}

//PortE
void PortE_Init(){
SYSCTL_RCGCGPIO_R |=PORTE_SysRC;
while((SYSCTL_PRGPIO_R &PORTE_SysRC)==0);
GPIO_PORTE_LOCK_R= GPIO_LOCK_KEY;
SET_8bits(GPIO_PORTE_CR_R);
CLR_8bits(GPIO_PORTE_AFSEL_R);
CLR_4bits(GPIO_PORTE_AMSEL_R);
CLR_32bits(GPIO_PORTE_PCTL_R);
SET_8bits(GPIO_PORTE_DEN_R);
}

//PortF
void PortF_Init(){
SYSCTL_RCGCGPIO_R |=PORTF_SysRC;
while((SYSCTL_PRGPIO_R &PORTF_SysRC)==0);
GPIO_PORTF_LOCK_R= GPIO_LOCK_KEY;
SET_8bits(GPIO_PORTF_CR_R);
CLR_8bits(GPIO_PORTF_AFSEL_R);
CLR_4bits(GPIO_PORTF_AMSEL_R);
CLR_32bits(GPIO_PORTF_PCTL_R);
SET_8bits(GPIO_PORTF_DEN_R);

GPIO_PORTF_DIR_R|= LED_mask;
GPIO_PORTF_PUR_R|= BUTTONS_mask;
}
